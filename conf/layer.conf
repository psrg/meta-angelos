## conf/layer.conf
```bitbake
# We have a conf and classes directory, add to BBPATH
BBPATH .= ":${LAYERDIR}"

# We have a packages directory, add to BBFILES
BBFILES += "${LAYERDIR}/recipes-*/*/*.bb \
            ${LAYERDIR}/recipes-*/*/*.bbappend"

BBFILE_COLLECTIONS += "angelos"
BBFILE_PATTERN_angelos := "^${LAYERDIR}/"
BBFILE_PRIORITY_angelos = "4"

LAYERDEPENDS_fsl-arm-extra = "core fsl-arm-extra"
```

## conf/machine/angelos-anchor.conf
```bitbake
#@TYPE: Machine
#@NAME: Angelos Anchor
#@SOC: i.MX23
#@DESCRIPTION: Machine configuration for Angelos Anchor

include conf/machine/include/imx-base.inc
include conf/machine/include/tune-arm926ejs.inc

IMXBOOTLETS_MACHINE = "stmp378x_dev"
UBOOT_MACHINE = "mx23_olinuxino_config"

# Add a override for all iMX233-OLinuXino variants
SOC_FAMILY = "mxs:mx23:imx233-olinuxino"

KERNEL_IMAGETYPE = "uImage"
KERNEL_DEVICETREE = "imx23-olinuxino.dtb"

MACHINE_FEATURES = "apm usbgadget usbhost vfat"
```
